## config/west.yml
```yaml
manifest:
  remotes:
    - name: zmkfirmware
      url-base: https://github.com/AeternusDecorum
  projects:
    - name: zmk
      remote: zmkfirmware
      revision: paw
      import: app/west.yml
  self:
    path: config
```
